#include "hcms.h"

#include <stdint.h>
#include <stdarg.h>
#include <stdio.h>

#include "stm32g4xx_hal.h"

const uint8_t FontData7x5[ 0x80 ][ 5 ] =
{	
	{0x00,0x00,0x00,0x00,0x00},		// 0
	{0x00,0x00,0x00,0x00,0x00},		// 1
	{0x00,0x00,0x00,0x00,0x00},		// 2
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	{0x00,0x00,0x00,0x00,0x00},		//	7F
};

//HCMS_option
#define HCMS_SECTION 	(8)

#define PIN_HCMS_CLK    (GPIO_PIN_5)
#define PIN_HCMS_DA     (GPIO_PIN_6)
#define PIN_HCMS_RS     (GPIO_PIN_7)
#define PIN_HCMS_CE     (GPIO_PIN_6)
#define PIN_HCMS_RESET  (GPIO_PIN_9)

//GPIO Set / HIGH
#define HCMS_CLK_H 		(GPIOE->BSRR = (uint32_t)PIN_HCMS_CLK)
#define HCMS_DA_H 		(GPIOB->BSRR = (uint32_t)PIN_HCMS_DA)
#define HCMS_RS_H 		(GPIOB->BSRR = (uint32_t)PIN_HCMS_RS)
#define HCMS_CE_H 		(GPIOE->BSRR = (uint32_t)PIN_HCMS_CE)
#define HCMS_RESET_H 	(GPIOB->BSRR = (uint32_t)PIN_HCMS_RESET)

//GPIO CLR / LOW
#define HCMS_CLK_L 		(GPIOE->BRR = (uint32_t)PIN_HCMS_CLK)
#define HCMS_DA_L 		(GPIOB->BRR = (uint32_t)PIN_HCMS_DA)
#define HCMS_RS_L 		(GPIOB->BRR = (uint32_t)PIN_HCMS_RS)
#define HCMS_CE_L 		(GPIOE->BRR = (uint32_t)PIN_HCMS_CE)
#define HCMS_RESET_L 	(GPIOB->BRR = (uint32_t)PIN_HCMS_RESET)

void hcms_ctl_reg_load( char ctrl_reg )
{
    HCMS_RS_H;
    HCMS_CLK_H;
    HCMS_CE_L;
	
	//Load control register
	for( int16_t cnt = 0 ; cnt < 8 ; cnt++ )
	{
		HCMS_CLK_L;
		
		if( ctrl_reg & 0x80 )	HCMS_DA_H;
		else					HCMS_DA_L;

		HCMS_CLK_H;
		ctrl_reg <<= 1;
	}
	
	//Latch data to control word
	HCMS_CE_H;
	HCMS_CLK_L;
	HCMS_RS_L;
}

void hcms_data_load( char *buf )
{
	//select Dot register
    HCMS_CLK_H;
    HCMS_CE_L;
    uint8_t data;
	//Load control register
	for( int16_t i = 0 ; i < HCMS_SECTION ; i++ )
	{
        for( int16_t j = 4 ; j >= 0 ; j-- )
        {
            HCMS_CLK_L;
            data = FontData7x5[*buf][j];
            HCMS_CLK_H;
            for( int16_t k = 0 ; k < 7 ; k++)
            {
                HCMS_CLK_L;
                if(data & 0x01)	HCMS_DA_H;
                else			HCMS_DA_L;
                HCMS_CLK_H;
                data >>= 1;
            }
        }
        buf++;
	}
	HCMS_CE_H;
	HCMS_CLK_L;
}

void hcms_init( void )
{
	HCMS_RESET_L;
	HCMS_CE_H;
	HCMS_RS_L;
	HCMS_CLK_H;
	HCMS_RESET_H;

	hcms_ctl_reg_load( 0x81 );

	/*
	7: 0 to Select Control
	6: Sleep mode
	5:4 Peak Current Brightness Control
	3:0 PWM Brightness Control
	*/
	hcms_ctl_reg_load( 0x6d );	//non sleep mode bright level adjustment.
}

void hcmsprintf( char *pchar , ... )
{
    char buf[ 16 ] = { 0 , };
	
    va_list va_ptr;
	
    va_start( va_ptr , pchar );	 
    vsprintf( buf , pchar , va_ptr );
    va_end( va_ptr );
	
    hcms_data_load( buf );
}

